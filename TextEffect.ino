uint8_t charCounter = 0;
uint8_t charPosition = 0;

uint8_t characters[37][8] = {
  {0x3C, 0x7E, 0x66, 0x6E, 0x76, 0x66, 0x7E, 0x3C}, //0
  {0x18, 0x38, 0x38, 0x18, 0x18, 0x18, 0x18, 0x7E}, //1
  {0x3C, 0x7E, 0x46, 0x0C, 0x30, 0x62, 0x7E, 0x3C}, //2
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  {0x00, 0x00, 0x00, 0x7E, 0x7E, 0x00, 0x00, 0x00}  //-
};

void text() {
  if (loading) {
    clearCube();
    charPosition = -1;
    charCounter = 0;
    loading = false;
    currentEffectOriginalTime = TEXT_TIME;
    currentEffectTime = currentEffectOriginalTime * timeScale;
    textToDisplay.toUpperCase();
    textToDisplay = String(textToDisplay + " ");

    Serial.print(textToDisplay);
    char character;
    for (uint8_t i = 0; i < textToDisplay.length(); i++) {
      textToDisplay.replace("%C4%85", "A");
      textToDisplay.replace("%C4%87", "C");
      textToDisplay.replace("%C4%99", "E");
      textToDisplay.replace("%C5%82", "L");
      textToDisplay.replace("%C5%84", "N");
      textToDisplay.replace("%C3%B3", "O");
      textToDisplay.replace("%C5%9B", "S");
      textToDisplay.replace("%C5%BA", "Z");
      textToDisplay.replace("%C5%BC", "Z");
    }
    Serial.print(textToDisplay);
  }
  timer++;
  if (timer > currentEffectTime) {
    timer = 0;

    shift(POSITION_X);
    charPosition++;

    if (charPosition == 8) {
      charCounter++;
      if (charCounter > textToDisplay.length() - 1) {
        charCounter = 0;
      }
      charPosition = 0;
    }

    if (charPosition == 0) {
      for (uint8_t i = 0; i < 8; i++) {
        for (uint8_t j = 0; j < 8; j++) {
          if(textToDisplay[charCounter] >= '0' && textToDisplay[charCounter] <= '9'){
            cube[i][j] = BIT(characters[textToDisplay[charCounter] - '0'][i], j);
          }
          else if(textToDisplay[charCounter] >= 'A' && textToDisplay[charCounter] <= 'Z'){
            cube[i][j] = BIT(characters[textToDisplay[charCounter] - 'A' + 10][i], j);
          }
          else if(textToDisplay[charCounter] == '-'){
            cube[i][j] = BIT(characters[36][i], j);
          }
        }
      }
    }
  }
}
